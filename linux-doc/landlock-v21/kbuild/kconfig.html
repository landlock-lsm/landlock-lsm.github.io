## linux-doc/landlock-v21/kbuild/kconfig.html
```kconfig
<!DOCTYPE html>
<!--[if IE 8]><html class="no-js lt-ie9" lang="en" > <![endif]-->
<!--[if gt IE 8]><!--> <html class="no-js" lang="en" > <!--<![endif]-->
<head>
  <meta charset="utf-8">
  
  <meta name="viewport" content="width=device-width, initial-scale=1.0">
  
  <title>Kconfig make config &mdash; The Linux Kernel  documentation</title>
  

  
  
  
  

  
  <script type="text/javascript" src="../_static/js/modernizr.min.js"></script>
  
    
      <script type="text/javascript" id="documentation_options" data-url_root="../" src="../_static/documentation_options.js"></script>
        <script type="text/javascript" src="../_static/jquery.js"></script>
        <script type="text/javascript" src="../_static/underscore.js"></script>
        <script type="text/javascript" src="../_static/doctools.js"></script>
        <script type="text/javascript" src="../_static/language_data.js"></script>
    
    <script type="text/javascript" src="../_static/js/theme.js"></script>

    

  
  <link rel="stylesheet" href="../_static/css/theme.css" type="text/css" />
  <link rel="stylesheet" href="../_static/pygments.css" type="text/css" />
  <link rel="stylesheet" href="../_static/theme_overrides.css" type="text/css" />
    <link rel="index" title="Index" href="../genindex.html" />
    <link rel="search" title="Search" href="../search.html" />
    <link rel="next" title="Linux Kernel Makefiles" href="makefiles.html" />
    <link rel="prev" title="Kbuild" href="kbuild.html" /> 
</head>

<body class="wy-body-for-nav">

   
  <div class="wy-grid-for-nav">
    
    <nav data-toggle="wy-nav-shift" class="wy-nav-side">
      <div class="wy-side-scroll">
        <div class="wy-side-nav-search" >
          

          
            <a href="../index.html" class="icon icon-home"> The Linux Kernel
          

          
          </a>

          
            
            
              <div class="version">
                5.9.0-rc8
              </div>
            
          

          
<div role="search">
  <form id="rtd-search-form" class="wy-form" action="../search.html" method="get">
    <input type="text" name="q" placeholder="Search docs" />
    <input type="hidden" name="check_keywords" value="yes" />
    <input type="hidden" name="area" value="default" />
  </form>
</div>

          
        </div>

        <div class="wy-menu wy-menu-vertical" data-spy="affix" role="navigation" aria-label="main navigation">
          
            
            
              
            
            
              <ul class="current">
<li class="toctree-l1"><a class="reference internal" href="../admin-guide/index.html">The Linux kernel user’s and administrator’s guide</a></li>
<li class="toctree-l1 current"><a class="reference internal" href="index.html">Kernel Build System</a><ul class="current">
<li class="toctree-l2"><a class="reference internal" href="kconfig-language.html">Kconfig Language</a></li>
<li class="toctree-l2"><a class="reference internal" href="kconfig-macro-language.html">Kconfig macro language</a></li>
<li class="toctree-l2"><a class="reference internal" href="kbuild.html">Kbuild</a></li>
<li class="toctree-l2 current"><a class="current reference internal" href="#">Kconfig make config</a><ul>
<li class="toctree-l3"><a class="reference internal" href="#general">General</a></li>
<li class="toctree-l3"><a class="reference internal" href="#kconfig-config">KCONFIG_CONFIG</a></li>
<li class="toctree-l3"><a class="reference internal" href="#kconfig-overwriteconfig">KCONFIG_OVERWRITECONFIG</a></li>
<li class="toctree-l3"><a class="reference internal" href="#config"><cite>CONFIG_</cite></a></li>
<li class="toctree-l3"><a class="reference internal" href="#kconfig-allconfig">KCONFIG_ALLCONFIG</a></li>
<li class="toctree-l3"><a class="reference internal" href="#kconfig-seed">KCONFIG_SEED</a></li>
<li class="toctree-l3"><a class="reference internal" href="#kconfig-probability">KCONFIG_PROBABILITY</a></li>
<li class="toctree-l3"><a class="reference internal" href="#kconfig-nosilentupdate">KCONFIG_NOSILENTUPDATE</a></li>
<li class="toctree-l3"><a class="reference internal" href="#kconfig-autoconfig">KCONFIG_AUTOCONFIG</a></li>
<li class="toctree-l3"><a class="reference internal" href="#kconfig-autoheader">KCONFIG_AUTOHEADER</a></li>
<li class="toctree-l3"><a class="reference internal" href="#menuconfig">menuconfig</a></li>
<li class="toctree-l3"><a class="reference internal" href="#menuconfig-color">MENUCONFIG_COLOR</a></li>
<li class="toctree-l3"><a class="reference internal" href="#menuconfig-mode">MENUCONFIG_MODE</a></li>
<li class="toctree-l3"><a class="reference internal" href="#nconfig">nconfig</a></li>
<li class="toctree-l3"><a class="reference internal" href="#nconfig-mode">NCONFIG_MODE</a></li>
<li class="toctree-l3"><a class="reference internal" href="#xconfig">xconfig</a></li>
<li class="toctree-l3"><a class="reference internal" href="#gconfig">gconfig</a></li>
</ul>
</li>
<li class="toctree-l2"><a class="reference internal" href="makefiles.html">Linux Kernel Makefiles</a></li>
<li class="toctree-l2"><a class="reference internal" href="modules.html">Building External Modules</a></li>
<li class="toctree-l2"><a class="reference internal" href="headers_install.html">Exporting kernel headers for use by userspace</a></li>
<li class="toctree-l2"><a class="reference internal" href="issues.html">Recursion issues</a></li>
<li class="toctree-l2"><a class="reference internal" href="reproducible-builds.html">Reproducible builds</a></li>
<li class="toctree-l2"><a class="reference internal" href="gcc-plugins.html">GCC plugin infrastructure</a></li>
<li class="toctree-l2"><a class="reference internal" href="llvm.html">Building Linux with Clang/LLVM</a></li>
</ul>
</li>
</ul>
<ul>
<li class="toctree-l1"><a class="reference internal" href="../firmware-guide/index.html">The Linux kernel firmware guide</a></li>
<li class="toctree-l1"><a class="reference internal" href="../devicetree/index.html">Open Firmware and Device Tree</a></li>
</ul>
<ul>
<li class="toctree-l1"><a class="reference internal" href="../userspace-api/index.html">The Linux kernel user-space API guide</a></li>
</ul>
<ul>
<li class="toctree-l1"><a class="reference internal" href="../process/index.html">Working with the kernel development community</a></li>
<li class="toctree-l1"><a class="reference internal" href="../dev-tools/index.html">Development tools for the kernel</a></li>
<li class="toctree-l1"><a class="reference internal" href="../doc-guide/index.html">How to write kernel documentation</a></li>
<li class="toctree-l1"><a class="reference internal" href="../kernel-hacking/index.html">Kernel Hacking Guides</a></li>
<li class="toctree-l1"><a class="reference internal" href="../trace/index.html">Linux Tracing Technologies</a></li>
<li class="toctree-l1"><a class="reference internal" href="../maintainer/index.html">Kernel Maintainer Handbook</a></li>
<li class="toctree-l1"><a class="reference internal" href="../fault-injection/index.html">fault-injection</a></li>
<li class="toctree-l1"><a class="reference internal" href="../livepatch/index.html">Kernel Livepatching</a></li>
</ul>
<ul>
<li class="toctree-l1"><a class="reference internal" href="../driver-api/index.html">The Linux driver implementer’s API guide</a></li>
<li class="toctree-l1"><a class="reference internal" href="../core-api/index.html">Core API Documentation</a></li>
<li class="toctree-l1"><a class="reference internal" href="../locking/index.html">locking</a></li>
<li class="toctree-l1"><a class="reference internal" href="../accounting/index.html">Accounting</a></li>
<li class="toctree-l1"><a class="reference internal" href="../block/index.html">Block</a></li>
<li class="toctree-l1"><a class="reference internal" href="../cdrom/index.html">cdrom</a></li>
<li class="toctree-l1"><a class="reference internal" href="../cpu-freq/index.html">Linux CPUFreq - CPU frequency and voltage scaling code in the Linux(TM) kernel</a></li>
<li class="toctree-l1"><a class="reference internal" href="../ide/index.html">Integrated Drive Electronics (IDE)</a></li>
<li class="toctree-l1"><a class="reference internal" href="../fb/index.html">Frame Buffer</a></li>
<li class="toctree-l1"><a class="reference internal" href="../fpga/index.html">fpga</a></li>
<li class="toctree-l1"><a class="reference internal" href="../hid/index.html">Human Interface Devices (HID)</a></li>
<li class="toctree-l1"><a class="reference internal" href="../i2c/index.html">I2C/SMBus Subsystem</a></li>
<li class="toctree-l1"><a class="reference internal" href="../iio/index.html">Industrial I/O</a></li>
<li class="toctree-l1"><a class="reference internal" href="../isdn/index.html">ISDN</a></li>
<li class="toctree-l1"><a class="reference internal" href="../infiniband/index.html">InfiniBand</a></li>
<li class="toctree-l1"><a class="reference internal" href="../leds/index.html">LEDs</a></li>
<li class="toctree-l1"><a class="reference internal" href="../netlabel/index.html">NetLabel</a></li>
<li class="toctree-l1"><a class="reference internal" href="../networking/index.html">Linux Networking Documentation</a></li>
<li class="toctree-l1"><a class="reference internal" href="../pcmcia/index.html">pcmcia</a></li>
<li class="toctree-l1"><a class="reference internal" href="../power/index.html">Power Management</a></li>
<li class="toctree-l1"><a class="reference internal" href="../target/index.html">TCM Virtual Device</a></li>
<li class="toctree-l1"><a class="reference internal" href="../timers/index.html">timers</a></li>
<li class="toctree-l1"><a class="reference internal" href="../spi/index.html">Serial Peripheral Interface (SPI)</a></li>
<li class="toctree-l1"><a class="reference internal" href="../w1/index.html">1-Wire Subsystem</a></li>
<li class="toctree-l1"><a class="reference internal" href="../watchdog/index.html">Linux Watchdog Support</a></li>
<li class="toctree-l1"><a class="reference internal" href="../virt/index.html">Linux Virtualization Support</a></li>
<li class="toctree-l1"><a class="reference internal" href="../input/index.html">The Linux Input Documentation</a></li>
<li class="toctree-l1"><a class="reference internal" href="../hwmon/index.html">Linux Hardware Monitoring</a></li>
<li class="toctree-l1"><a class="reference internal" href="../gpu/index.html">Linux GPU Driver Developer’s Guide</a></li>
<li class="toctree-l1"><a class="reference internal" href="../security/index.html">Security Documentation</a></li>
<li class="toctree-l1"><a class="reference internal" href="../sound/index.html">Linux Sound Subsystem Documentation</a></li>
<li class="toctree-l1"><a class="reference internal" href="../crypto/index.html">Linux Kernel Crypto API</a></li>
<li class="toctree-l1"><a class="reference internal" href="../filesystems/index.html">Filesystems in the Linux kernel</a></li>
<li class="toctree-l1"><a class="reference internal" href="../vm/index.html">Linux Memory Management Documentation</a></li>
<li class="toctree-l1"><a class="reference internal" href="../bpf/index.html">BPF Documentation</a></li>
<li class="toctree-l1"><a class="reference internal" href="../usb/index.html">USB support</a></li>
<li class="toctree-l1"><a class="reference internal" href="../PCI/index.html">Linux PCI Bus Subsystem</a></li>
<li class="toctree-l1"><a class="reference internal" href="../scsi/index.html">Linux SCSI Subsystem</a></li>
<li class="toctree-l1"><a class="reference internal" href="../misc-devices/index.html">Assorted Miscellaneous Devices Documentation</a></li>
<li class="toctree-l1"><a class="reference internal" href="../scheduler/index.html">Linux Scheduler</a></li>
<li class="toctree-l1"><a class="reference internal" href="../mhi/index.html">MHI</a></li>
</ul>
<ul>
<li class="toctree-l1"><a class="reference internal" href="../asm-annotations.html">Assembler Annotations</a></li>
</ul>
<ul>
<li class="toctree-l1"><a class="reference internal" href="../arm/index.html">ARM Architecture</a></li>
<li class="toctree-l1"><a class="reference internal" href="../arm64/index.html">ARM64 Architecture</a></li>
<li class="toctree-l1"><a class="reference internal" href="../ia64/index.html">IA-64 Architecture</a></li>
<li class="toctree-l1"><a class="reference internal" href="../m68k/index.html">m68k Architecture</a></li>
<li class="toctree-l1"><a class="reference internal" href="../mips/index.html">MIPS-specific Documentation</a></li>
<li class="toctree-l1"><a class="reference internal" href="../nios2/nios2.html">Linux on the Nios II architecture</a></li>
<li class="toctree-l1"><a class="reference internal" href="../openrisc/index.html">OpenRISC Architecture</a></li>
<li class="toctree-l1"><a class="reference internal" href="../parisc/index.html">PA-RISC Architecture</a></li>
<li class="toctree-l1"><a class="reference internal" href="../powerpc/index.html">powerpc</a></li>
<li class="toctree-l1"><a class="reference internal" href="../riscv/index.html">RISC-V architecture</a></li>
<li class="toctree-l1"><a class="reference internal" href="../s390/index.html">s390 Architecture</a></li>
<li class="toctree-l1"><a class="reference internal" href="../sh/index.html">SuperH Interfaces Guide</a></li>
<li class="toctree-l1"><a class="reference internal" href="../sparc/index.html">Sparc Architecture</a></li>
<li class="toctree-l1"><a class="reference internal" href="../x86/index.html">x86-specific Documentation</a></li>
<li class="toctree-l1"><a class="reference internal" href="../xtensa/index.html">Xtensa Architecture</a></li>
</ul>
<ul>
<li class="toctree-l1"><a class="reference internal" href="../filesystems/ext4/index.html">ext4 Data Structures and Algorithms</a></li>
</ul>
<ul>
<li class="toctree-l1"><a class="reference internal" href="../staging/index.html">Unsorted Documentation</a></li>
<li class="toctree-l1"><a class="reference internal" href="../staging/index.html#atomic-types">Atomic Types</a></li>
<li class="toctree-l1"><a class="reference internal" href="../staging/index.html#atomic-bitops">Atomic bitops</a></li>
<li class="toctree-l1"><a class="reference internal" href="../staging/index.html#memory-barriers">Memory Barriers</a></li>
<li class="toctree-l1"><a class="reference internal" href="../watch_queue.html">General notification mechanism</a></li>
</ul>
<ul>
<li class="toctree-l1"><a class="reference internal" href="../translations/index.html">Translations</a></li>
</ul>

            
          
        </div>
      </div>
    </nav>

    <section data-toggle="wy-nav-shift" class="wy-nav-content-wrap">

      
      <nav class="wy-nav-top" aria-label="top navigation">
        
          <i data-toggle="wy-nav-top" class="fa fa-bars"></i>
          <a href="../index.html">The Linux Kernel</a>
        
      </nav>


      <div class="wy-nav-content">
        
        <div class="rst-content">
        
          















<div role="navigation" aria-label="breadcrumbs navigation">

  <ul class="wy-breadcrumbs">
    
      <li><a href="../index.html">Docs</a> &raquo;</li>
        
          <li><a href="index.html">Kernel Build System</a> &raquo;</li>
        
      <li>Kconfig make config</li>
    
    
      <li class="wy-breadcrumbs-aside">
        
            
            <a href="../_sources/kbuild/kconfig.rst.txt" rel="nofollow"> View page source</a>
          
        
      </li>
    
  </ul>

  
  <hr/>
</div>
          <div role="main" class="document" itemscope="itemscope" itemtype="http://schema.org/Article">
           <div itemprop="articleBody">
            
  <div class="section" id="kconfig-make-config">
<h1>Kconfig make config<a class="headerlink" href="#kconfig-make-config" title="Permalink to this headline">¶</a></h1>
<p>This file contains some assistance for using <cite>make *config</cite>.</p>
<p>Use “make help” to list all of the possible configuration targets.</p>
<p>The xconfig (‘qconf’), menuconfig (‘mconf’), and nconfig (‘nconf’)
programs also have embedded help text.  Be sure to check that for
navigation, search, and other general help text.</p>
<div class="section" id="general">
<h2>General<a class="headerlink" href="#general" title="Permalink to this headline">¶</a></h2>
<p>New kernel releases often introduce new config symbols.  Often more
important, new kernel releases may rename config symbols.  When
this happens, using a previously working .config file and running
“make oldconfig” won’t necessarily produce a working new kernel
for you, so you may find that you need to see what NEW kernel
symbols have been introduced.</p>
<p>To see a list of new config symbols, use:</p>
<div class="highlight-none notranslate"><div class="highlight"><pre><span></span>cp user/some/old.config .config
make listnewconfig
</pre></div>
</div>
<p>and the config program will list any new symbols, one per line.</p>
<p>Alternatively, you can use the brute force method:</p>
<div class="highlight-none notranslate"><div class="highlight"><pre><span></span>make oldconfig
scripts/diffconfig .config.old .config | less
</pre></div>
</div>
<hr class="docutils" />
<p>Environment variables for <cite>*config</cite></p>
</div>
<div class="section" id="kconfig-config">
<h2>KCONFIG_CONFIG<a class="headerlink" href="#kconfig-config" title="Permalink to this headline">¶</a></h2>
<p>This environment variable can be used to specify a default kernel config
file name to override the default name of “.config”.</p>
</div>
<div class="section" id="kconfig-overwriteconfig">
<h2>KCONFIG_OVERWRITECONFIG<a class="headerlink" href="#kconfig-overwriteconfig" title="Permalink to this headline">¶</a></h2>
<p>If you set KCONFIG_OVERWRITECONFIG in the environment, Kconfig will not
break symlinks when .config is a symlink to somewhere else.</p>
</div>
<div class="section" id="config">
<h2><cite>CONFIG_</cite><a class="headerlink" href="#config" title="Permalink to this headline">¶</a></h2>
<p>If you set <cite>CONFIG_</cite> in the environment, Kconfig will prefix all symbols
with its value when saving the configuration, instead of using the default,
<cite>CONFIG_</cite>.</p>
<hr class="docutils" />
<p>Environment variables for ‘{allyes/allmod/allno/rand}config’</p>
</div>
<div class="section" id="kconfig-allconfig">
<h2>KCONFIG_ALLCONFIG<a class="headerlink" href="#kconfig-allconfig" title="Permalink to this headline">¶</a></h2>
<p>(partially based on lkml email from/by Rob Landley, re: miniconfig)</p>
<hr class="docutils" />
<p>The allyesconfig/allmodconfig/allnoconfig/randconfig variants can also
use the environment variable KCONFIG_ALLCONFIG as a flag or a filename
that contains config symbols that the user requires to be set to a
specific value.  If KCONFIG_ALLCONFIG is used without a filename where
KCONFIG_ALLCONFIG == “” or KCONFIG_ALLCONFIG == “1”, <cite>make *config</cite>
checks for a file named “all{yes/mod/no/def/random}.config”
(corresponding to the <cite>*config</cite> command that was used) for symbol values
that are to be forced.  If this file is not found, it checks for a
file named “all.config” to contain forced values.</p>
<p>This enables you to create “miniature” config (miniconfig) or custom
config files containing just the config symbols that you are interested
in.  Then the kernel config system generates the full .config file,
including symbols of your miniconfig file.</p>
<p>This ‘KCONFIG_ALLCONFIG’ file is a config file which contains
(usually a subset of all) preset config symbols.  These variable
settings are still subject to normal dependency checks.</p>
<p>Examples:</p>
<div class="highlight-none notranslate"><div class="highlight"><pre><span></span>KCONFIG_ALLCONFIG=custom-notebook.config make allnoconfig
</pre></div>
</div>
<p>or:</p>
<div class="highlight-none notranslate"><div class="highlight"><pre><span></span>KCONFIG_ALLCONFIG=mini.config make allnoconfig
</pre></div>
</div>
<p>or:</p>
<div class="highlight-none notranslate"><div class="highlight"><pre><span></span>make KCONFIG_ALLCONFIG=mini.config allnoconfig
</pre></div>
</div>
<p>These examples will disable most options (allnoconfig) but enable or
disable the options that are explicitly listed in the specified
mini-config files.</p>
<hr class="docutils" />
<p>Environment variables for ‘randconfig’</p>
</div>
<div class="section" id="kconfig-seed">
<h2>KCONFIG_SEED<a class="headerlink" href="#kconfig-seed" title="Permalink to this headline">¶</a></h2>
<p>You can set this to the integer value used to seed the RNG, if you want
to somehow debug the behaviour of the kconfig parser/frontends.
If not set, the current time will be used.</p>
</div>
<div class="section" id="kconfig-probability">
<h2>KCONFIG_PROBABILITY<a class="headerlink" href="#kconfig-probability" title="Permalink to this headline">¶</a></h2>
<p>This variable can be used to skew the probabilities. This variable can
be unset or empty, or set to three different formats:</p>
<blockquote>
<div><table border="1" class="docutils">
<colgroup>
<col width="37%" />
<col width="29%" />
<col width="34%" />
</colgroup>
<thead valign="bottom">
<tr class="row-odd"><th class="head">KCONFIG_PROBABILITY</th>
<th class="head">y:n split</th>
<th class="head">y:m:n split</th>
</tr>
</thead>
<tbody valign="top">
<tr class="row-even"><td>unset or empty</td>
<td>50  : 50</td>
<td>33  : 33  : 34</td>
</tr>
<tr class="row-odd"><td>N</td>
<td>N  : 100-N</td>
<td>N/2 : N/2 : 100-N</td>
</tr>
<tr class="row-even"><td>[1] N:M</td>
<td>N+M : 100-(N+M)</td>
<td>N  :  M  : 100-(N+M)</td>
</tr>
<tr class="row-odd"><td>[2] N:M:L</td>
<td>N  : 100-N</td>
<td>M  :  L  : 100-(M+L)</td>
</tr>
</tbody>
</table>
</div></blockquote>
<p>where N, M and L are integers (in base 10) in the range [0,100], and so
that:</p>
<blockquote>
<div><p>[1] N+M is in the range [0,100]</p>
<p>[2] M+L is in the range [0,100]</p>
</div></blockquote>
<p>Examples:</p>
<div class="highlight-none notranslate"><div class="highlight"><pre><span></span>KCONFIG_PROBABILITY=10
        10% of booleans will be set to &#39;y&#39;, 90% to &#39;n&#39;
        5% of tristates will be set to &#39;y&#39;, 5% to &#39;m&#39;, 90% to &#39;n&#39;
KCONFIG_PROBABILITY=15:25
        40% of booleans will be set to &#39;y&#39;, 60% to &#39;n&#39;
        15% of tristates will be set to &#39;y&#39;, 25% to &#39;m&#39;, 60% to &#39;n&#39;
KCONFIG_PROBABILITY=10:15:15
        10% of booleans will be set to &#39;y&#39;, 90% to &#39;n&#39;
        15% of tristates will be set to &#39;y&#39;, 15% to &#39;m&#39;, 70% to &#39;n&#39;
</pre></div>
</div>
<hr class="docutils" />
<p>Environment variables for ‘syncconfig’</p>
</div>
<div class="section" id="kconfig-nosilentupdate">
<h2>KCONFIG_NOSILENTUPDATE<a class="headerlink" href="#kconfig-nosilentupdate" title="Permalink to this headline">¶</a></h2>
<p>If this variable has a non-blank value, it prevents silent kernel
config updates (requires explicit updates).</p>
</div>
<div class="section" id="kconfig-autoconfig">
<h2>KCONFIG_AUTOCONFIG<a class="headerlink" href="#kconfig-autoconfig" title="Permalink to this headline">¶</a></h2>
<p>This environment variable can be set to specify the path &amp; name of the
“auto.conf” file.  Its default value is “include/config/auto.conf”.</p>
</div>
<div class="section" id="kconfig-autoheader">
<h2>KCONFIG_AUTOHEADER<a class="headerlink" href="#kconfig-autoheader" title="Permalink to this headline">¶</a></h2>
<p>This environment variable can be set to specify the path &amp; name of the
“autoconf.h” (header) file.
Its default value is “include/generated/autoconf.h”.</p>
</div>
<hr class="docutils" />
<div class="section" id="menuconfig">
<h2>menuconfig<a class="headerlink" href="#menuconfig" title="Permalink to this headline">¶</a></h2>
<p>SEARCHING for CONFIG symbols</p>
<p>Searching in menuconfig:</p>
<blockquote>
<div><p>The Search function searches for kernel configuration symbol
names, so you have to know something close to what you are
looking for.</p>
<p>Example:</p>
<div class="highlight-none notranslate"><div class="highlight"><pre><span></span>/hotplug
This lists all config symbols that contain &quot;hotplug&quot;,
e.g., HOTPLUG_CPU, MEMORY_HOTPLUG.
</pre></div>
</div>
<p>For search help, enter / followed by TAB-TAB (to highlight
&lt;Help&gt;) and Enter.  This will tell you that you can also use
regular expressions (regexes) in the search string, so if you
are not interested in MEMORY_HOTPLUG, you could try:</p>
<div class="highlight-none notranslate"><div class="highlight"><pre><span></span>/^hotplug
</pre></div>
</div>
<p>When searching, symbols are sorted thus:</p>
<blockquote>
<div><ul class="simple">
<li>first, exact matches, sorted alphabetically (an exact match
is when the search matches the complete symbol name);</li>
<li>then, other matches, sorted alphabetically.</li>
</ul>
</div></blockquote>
<p>For example: ^ATH.K matches:</p>
<blockquote>
<div>ATH5K ATH9K ATH5K_AHB ATH5K_DEBUG […] ATH6KL ATH6KL_DEBUG
[…] ATH9K_AHB ATH9K_BTCOEX_SUPPORT ATH9K_COMMON […]</div></blockquote>
<p>of which only ATH5K and ATH9K match exactly and so are sorted
first (and in alphabetical order), then come all other symbols,
sorted in alphabetical order.</p>
</div></blockquote>
<hr class="docutils" />
<p>User interface options for ‘menuconfig’</p>
</div>
<div class="section" id="menuconfig-color">
<h2>MENUCONFIG_COLOR<a class="headerlink" href="#menuconfig-color" title="Permalink to this headline">¶</a></h2>
<p>It is possible to select different color themes using the variable
MENUCONFIG_COLOR.  To select a theme use:</p>
<div class="highlight-none notranslate"><div class="highlight"><pre><span></span>make MENUCONFIG_COLOR=&lt;theme&gt; menuconfig
</pre></div>
</div>
<p>Available themes are:</p>
<div class="highlight-none notranslate"><div class="highlight"><pre><span></span>- mono       =&gt; selects colors suitable for monochrome displays
- blackbg    =&gt; selects a color scheme with black background
- classic    =&gt; theme with blue background. The classic look
- bluetitle  =&gt; a LCD friendly version of classic. (default)
</pre></div>
</div>
</div>
<div class="section" id="menuconfig-mode">
<h2>MENUCONFIG_MODE<a class="headerlink" href="#menuconfig-mode" title="Permalink to this headline">¶</a></h2>
<p>This mode shows all sub-menus in one large tree.</p>
<p>Example:</p>
<div class="highlight-none notranslate"><div class="highlight"><pre><span></span>make MENUCONFIG_MODE=single_menu menuconfig
</pre></div>
</div>
</div>
<hr class="docutils" />
<div class="section" id="nconfig">
<h2>nconfig<a class="headerlink" href="#nconfig" title="Permalink to this headline">¶</a></h2>
<p>nconfig is an alternate text-based configurator.  It lists function
keys across the bottom of the terminal (window) that execute commands.
You can also just use the corresponding numeric key to execute the
commands unless you are in a data entry window.  E.g., instead of F6
for Save, you can just press 6.</p>
<p>Use F1 for Global help or F3 for the Short help menu.</p>
<p>Searching in nconfig:</p>
<blockquote>
<div><p>You can search either in the menu entry “prompt” strings
or in the configuration symbols.</p>
<p>Use / to begin a search through the menu entries.  This does
not support regular expressions.  Use &lt;Down&gt; or &lt;Up&gt; for
Next hit and Previous hit, respectively.  Use &lt;Esc&gt; to
terminate the search mode.</p>
<p>F8 (SymSearch) searches the configuration symbols for the
given string or regular expression (regex).</p>
</div></blockquote>
</div>
<div class="section" id="nconfig-mode">
<h2>NCONFIG_MODE<a class="headerlink" href="#nconfig-mode" title="Permalink to this headline">¶</a></h2>
<p>This mode shows all sub-menus in one large tree.</p>
<p>Example:</p>
<div class="highlight-none notranslate"><div class="highlight"><pre><span></span>make NCONFIG_MODE=single_menu nconfig
</pre></div>
</div>
</div>
<hr class="docutils" />
<div class="section" id="xconfig">
<h2>xconfig<a class="headerlink" href="#xconfig" title="Permalink to this headline">¶</a></h2>
<p>Searching in xconfig:</p>
<blockquote>
<div><p>The Search function searches for kernel configuration symbol
names, so you have to know something close to what you are
looking for.</p>
<p>Example:</p>
<div class="highlight-none notranslate"><div class="highlight"><pre><span></span>Ctrl-F hotplug
</pre></div>
</div>
<p>or:</p>
<div class="highlight-none notranslate"><div class="highlight"><pre><span></span>Menu: File, Search, hotplug
</pre></div>
</div>
<p>lists all config symbol entries that contain “hotplug” in
the symbol name.  In this Search dialog, you may change the
config setting for any of the entries that are not grayed out.
You can also enter a different search string without having
to return to the main menu.</p>
</div></blockquote>
</div>
<hr class="docutils" />
<div class="section" id="gconfig">
<h2>gconfig<a class="headerlink" href="#gconfig" title="Permalink to this headline">¶</a></h2>
<p>Searching in gconfig:</p>
<blockquote>
<div>There is no search command in gconfig.  However, gconfig does
have several different viewing choices, modes, and options.</div></blockquote>
</div>
</div>


           </div>
           
          </div>
          <footer>
  
    <div class="rst-footer-buttons" role="navigation" aria-label="footer navigation">
      
        <a href="makefiles.html" class="btn btn-neutral float-right" title="Linux Kernel Makefiles" accesskey="n" rel="next">Next <span class="fa fa-arrow-circle-right"></span></a>
      
      
        <a href="kbuild.html" class="btn btn-neutral float-left" title="Kbuild" accesskey="p" rel="prev"><span class="fa fa-arrow-circle-left"></span> Previous</a>
      
    </div>
  

  <hr/>

  <div role="contentinfo">
    <p>
        &copy; Copyright The kernel development community

    </p>
  </div>
  Built with <a href="http://sphinx-doc.org/">Sphinx</a> using a <a href="https://github.com/rtfd/sphinx_rtd_theme">theme</a> provided by <a href="https://readthedocs.org">Read the Docs</a>. 

</footer>

        </div>
      </div>

    </section>

  </div>
  


  <script type="text/javascript">
      jQuery(function () {
          SphinxRtdTheme.Navigation.enable(true);
      });
  </script>

  
  
    
   

</body>
</html>
```
